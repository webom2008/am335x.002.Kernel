## linux-3.2.0/drivers/net/wireless/brcm80211/Kconfig
```kconfig
config BRCMFMAC
	tristate "Broadcom IEEE802.11n embedded FullMAC WLAN driver"
	depends on MMC
	depends on CFG80211
	select BRCMUTIL
	select FW_LOADER
	---help---
	  This module adds support for embedded wireless adapters based on
	  Broadcom IEEE802.11n FullMAC chipsets.  This driver uses the kernel's
	  wireless extensions subsystem.  If you choose to build a module,
	  it'll be called brcmfmac.ko.
	
config SDIO_DHD_CDC_WIFI_40181_MODULE
	tristate "Broadcom 4329/4330 wireless cards support"
	depends on MMC
	---help---
	  This module adds support for wireless adapters based on
	  Broadcom 4329/4330 chipset.

choice
    depends on SDIO_DHD_CDC_WIFI_40181_MODULE
    prompt "Wi-Fi module type"

config BCM40181_WIFI
    bool "40181 without bluetooth"
config BCM40183_WIFI
    bool "40183 with bluetooth"

endchoice

#choice
#    depends on SDIO_DHD_CDC_WIFI_40181_MODULE
#    prompt "Interrupt type"
config BCMDHD_OOB
	depends on SDIO_DHD_CDC_WIFI_40181_MODULE
	bool "Out-of-Band Interrupt"
	default y
	---help---
	  Out-of-Band interrupt through WL_HOST_WAKE.

config SDIO_HARD_IRQ
	depends on SDIO_DHD_CDC_WIFI_40181_MODULE
	bool "In-Band Interrupt"
	default n
	---help---
		In-Band interrupt through SDIO DAT[1]
#endchoice

config BCMDHD_FW_PATH
	depends on SDIO_DHD_CDC_WIFI_40181_MODULE
	string "Firmware path"
#	default "/system/etc/wifi/40183/fw_bcmdhd.bin"
	default "/lib/firmware/brcm/brcmfmac43362-sdio.bin"
	
	---help---
	  Path to the firmware file.

config BCMDHD_NVRAM_PATH
	depends on SDIO_DHD_CDC_WIFI_40181_MODULE
	string "NVRAM path"
#	default "/system/etc/wifi/40183/nvram.txt"
	default "/lib/firmware/brcm/brcmfmac43362-sdio.txt"
	---help---
	  Path to the calibration file.

config BCMDHD_WEXT
	bool "Enable WEXT support"
	depends on SDIO_DHD_CDC_WIFI_40181_MODULE && CFG80211 = n
	select WIRELESS_EXT
	select WEXT_PRIV
	help
	  Enables WEXT support

config DHD_USE_SCHED_SCAN
	bool "Use CFG80211 sched scan"
	depends on SDIO_DHD_CDC_WIFI_40181_MODULE && CFG80211
	default n
	---help---
	  Use CFG80211 sched scan

#choice
#    depends on BCMDHD
#    prompt "Interrupt type"
config BCMDHD_OOB
	depends on BCMDHD
	bool "Out-of-Band Interrupt"
	default y
	---help---
		Interrupt through WL_HOST_WAKE.
config SDIO_HARD_IRQ
	depends on  BCMDHD
	bool "In-Band Interrupt"
	default n
	---help---
		Interrupt through SDIO DAT[1]
#endchoice
```

## linux-3.2.0/drivers/nursecall/Kconfig
```kconfig
# MIUD configuration
#

config NURSECALL_DRIVER
		tristate "nursecall_driver"
		default y
		---help---
		rrmt using touch screen input user interface
```

## linux-3.2.0/drivers/pauseled/Kconfig
```kconfig
# MIUD configuration
#

config PAUSELED_DRIVER
		tristate "pauseled_driver"
		default y
		---help---
		rrmt using touch screen input user interface
```

## linux-3.2.0/drivers/test/Kconfig
```kconfig
# MIUD configuration
#

config LED_DRIVER
		tristate "led drivers"
		default y
		---help---
		rrmt using touch screen input user interface
```
